## conf/distro/tuxbox.conf
```bitbake
# This is the tuxbox-neutrino build based on yocto poky

DISTRO_VERSION = "rocko"
DISTRO_VERSION_NUMBER = "${DISTRO_VERSION_NUMBER_MAJOR}.${DISTRO_VERSION_NUMBER_MINOR}"
DISTRO_VERSION_NUMBER_MAJOR = "2"
DISTRO_VERSION_NUMBER_MINOR = "3"
SDK_VERSION ??= "rocko"

TCLIBC ?= "glibc"
TCLIBCAPPEND ?= ""
TMPDIR .= "${TCLIBCAPPEND}"
TMPDIR = "${TOPDIR}/tmp"

QA_LOGFILE = "${TMPDIR}/qa.log"

OEINCLUDELOGS ?= "yes"
PATCHRESOLVE = "noop"

PRSERV_HOST = "localhost:0"
RELEASE_STATE = "1"

KERNEL_CONSOLE ?= "ttyS0"
KEEPUIMAGE ??= "yes"

IMAGE_LINGUAS ?= "en-us de-de fr-fr"
ENABLE_BINARY_LOCALE_GENERATION ?= "1"
LOCALE_UTF8_IS_DEFAULT ?= "1"
LOCALE_UTF8_ONLY ?= "0"

SSTATE_DIR = "${TOPDIR}/sstate-cache"
BB_GENERATE_MIRROR_TARBALLS ??= "0"
BBINCLUDELOGS ??= "yes"
BB_STRICT_CHECKSUM = "1"
NO32LIBS ??= "1"

USER_CLASSES ?= "buildstats image-mklibs image-prelink"

DISTRO_FEATURES_DEFAULT ?= "acl alsa argp bluetooth ext2 irda largefile pam systemd usbgadget usbhost wifi xattr nfs zeroconf nfc"
DISTRO_FEATURES_LIBC_DEFAULT ?= "ipv4 ipv6 libc-backtrace libc-big-macros libc-bsd libc-cxx-tests libc-catgets libc-charsets libc-crypt \
					libc-crypt-ufc libc-db-aliases libc-envz libc-fcvt libc-fmtmsg libc-fstab libc-ftraverse \
					libc-getlogin libc-idn libc-inet-anl libc-libm libc-locales libc-locale-code \
					libc-memusage libc-nis libc-nsswitch libc-rcmd libc-rtld-debug libc-spawn libc-streams libc-sunrpc \
					libc-utmp libc-utmpx libc-wordexp libc-posix-clang-wchar libc-posix-regexp libc-posix-regexp-glibc \
					libc-posix-wchar-io"
DISTRO_FEATURES_LIBC ?= "${DISTRO_FEATURES_LIBC_DEFAULT}"
DISTRO_FEATURES_LIBC_class-nativesdk = "${DISTRO_FEATURES_LIBC_DEFAULT}"
DISTRO_FEATURES ?= "${DISTRO_FEATURES_DEFAULT} ${DISTRO_FEATURES_LIBC}"

IMAGE_FEATURES ?= ""
EXTRA_IMAGE_FEATURES = "debug-tweaks package-management"

WHITELIST_GPL-3.0 ?= ""
LGPLv2_WHITELIST_GPL-3.0 ?= ""

COMMERCIAL_AUDIO_PLUGINS ?= ""
# COMMERCIAL_AUDIO_PLUGINS ?= "gst-plugins-ugly-mad gst-plugins-ugly-mpegaudioparse"
COMMERCIAL_VIDEO_PLUGINS ?= ""
# COMMERCIAL_VIDEO_PLUGINS ?= "gst-plugins-ugly-mpeg2dec gst-plugins-ugly-mpegstream gst-plugins-bad-mpegvideoparse"
# Set of common licenses used for license.bbclass
COMMON_LICENSE_DIR ??= "${COREBASE}/meta/files/common-licenses"

DISTRO_FEATURES_append = " systemd"
DISTRO_FEATURES_BACKFILL_CONSIDERED += "sysvinit"
VIRTUAL-RUNTIME_init_manager = "systemd"
VIRTUAL-RUNTIME_initscripts = "systemd-compat-units"

GIT_URL = "/media/sda1/service/git/etc-${TCLIBC}.git"

PREFERRED_PROVIDER_virtual/kernel = "linux-gfutures"
PREFERRED_PROVIDER_virtual/neutrino = "neutrino-mp-ax51"
PREFERRED_VERSION_linux-libc-headers = "4.10"
PREFFERED_PROVIDER_virtual/libstb-hal = "libstb-hal"
```

## conf/layer.conf
```bitbake
# We have a conf and classes directory, append to BBPATH
BBPATH .= ":${LAYERDIR}"

# We have a recipes directory, add to BBFILES
BBFILES += "${LAYERDIR}/recipes-*/*.bb ${LAYERDIR}/recipes-*/*.bbappend \
            ${LAYERDIR}/recipes-*/*/*.bb ${LAYERDIR}/recipes-*/*/*.bbappend"

BBFILE_COLLECTIONS += "ceryon-layer"
BBFILE_PATTERN_ceryon-layer := "^${LAYERDIR}/"
BBFILE_PRIORITY_ceryon-layer = "7"

LAYERSERIES_COMPAT_ceryon-layer = "gatesgarth"

# Additional license settings
#LICENSE_PATH += "${LAYERDIR}/files/custom-licenses"
#LICENSE_PATH += "${YOCTO_BASEDIR}/meta-neutrino/custom-licenses"
LICENSE_FLAGS_WHITELIST = "commercial"
```

## conf/machine/8100s.conf
```bitbake
SOC_FAMILY = "bcm7252s"

RCTYPE = "26"
RCNAME = "protek2"

RCTYPE_e4hdcombo = "24"
RCNAME_e4hdcombo = "e4hdcombo"

require conf/machine/include/ceryon-arm.inc

MTD_BOOTFS = "mmcblk0p1"
MTD_BLACK  = "mmcblk0"

#MACHINE_FEATURES += "colorlcd220 lcd220 ci dvb-c  emmc mmc linuxwifi swap kodi20 qthbbtv multitranscoding minitv mountboot v3d-nxpl"
MACHINE_FEATURES += "apm usbhost keyboard vfat ext2 wifi"

MACHINE_EXTRA_RRECOMMENDS += " \
    ceryon-lcd \
"

EXTRA_IMAGEDEPENDS += " \
    curl \
    "

MACHINE_EXTRA_RDEPENDS += " \
    curl \
    "

MACHINEBUILD ?= "e4hdultra"

MACHINE_EXTRA_RRECOMMENDS += " \
	kernel-modules \
"

## preferred versions
PREFERRED_VERSION_linux-libc-headers = "4.10"
PREFERRED_VERSION_nativesdk-linux-libc-headers = "4.10"

#BBMASK = "meta-vuplus/recipes-graphics/"
#BBMASK += "meta-fulan/recipes-graphics/"
#BBMASK += "meta-vuplus/recipes-webkit/"


## preferred providers
PREFERRED_PROVIDER_virtual/kernel = "linux-ceryon"
PREFFERED_PROVIDER_virtual/dvb-driver = "ceryon-dvb-modules-e4hd"
PREFERRED_PROVIDER_virtual/neutrino = "neutrino-mp"
PREFFERED_PROVIDER_virtual/libstb-hal = "libstb-hal"
PREFFERED_PROVIDER_virtual/screengrabber = "grab"
```

## conf/machine/bre2ze4k.conf
```bitbake
SOC_FAMILY = "bcm7251s"

FLASHSIZE = "1024"

require conf/machine/include/gfutures-arm.inc

MACHINE_FEATURES += "apm usbhost keyboard vfat ext2 wifi"

MTD_BOOTFS = "mmcblk0p1"
MTD_ROOTFS = "mmcblk0p3"
MTD_KERNEL = "mmcblk0p2"
KERNEL_FILE = "kernel.bin"
ROOTFS_FILE = "rootfs.tar.bz2"
MTD_BLACK  = "mmcblk0"

#BBMASK = "meta-vuplus/recipes-graphics/"
#BBMASK += "meta-fulan/recipes-graphics/"
#BBMASK += "meta-vuplus/recipes-webkit/"

MACHINEBUILD ?= "bre2ze4k"

MACHINE_EXTRA_RRECOMMENDS += " \
	kernel-modules \
"
## preferred versions
PREFERRED_VERSION_linux-libc-headers = "4.10"
PREFERRED_VERSION_nativesdk-linux-libc-headers = "4.10"

## preferred providers
PREFERRED_PROVIDER_virtual/kernel = "linux-gfutures"
PREFFERED_PROVIDER_virtual/dvb-driver = "gfutures-dvb-modules-bre2ze4k"
PREFERRED_PROVIDER_virtual/neutrino = "neutrino-mp"
PREFFERED_PROVIDER_virtual/libstb-hal = "libstb-hal"
PREFFERED_PROVIDER_virtual/screengrabber = "grab"
```

## conf/machine/hd51.conf
```bitbake
SOC_FAMILY = "bcm7251s"

FLASHSIZE = "1024"

require conf/machine/include/gfutures-arm.inc

MACHINE_FEATURES += "apm usbhost keyboard vfat ext2 wifi"




MACHINE_KERNEL_PR = "r0"

MTD_BOOTFS = "mmcblk0p1"
KERNEL_FILE = "kernel.bin"
ROOTFS_FILE = "rootfs.tar.bz2"
MTD_BLACK  = "mmcblk0"

#EXTRA_IMAGEDEPENDS += "\
#    ${@bb.utils.contains('MACHINEBUILD', 'bre2ze4k', ' enigma2-plugin-systemplugins-vfdcontrol' , '', d)} \
#    ${@bb.utils.contains('MACHINEBUILD', 'axultra', ' enigma2-plugin-systemplugins-vfdcontrol' , '', d)} \
#    "

#MACHINE_EXTRA_RDEPENDS += "\
#    ${@bb.utils.contains('MACHINEBUILD', 'bre2ze4k', ' enigma2-plugin-systemplugins-vfdcontrol' , '', d)} \
#    ${@bb.utils.contains('MACHINEBUILD', 'axultra', ' enigma2-plugin-systemplugins-vfdcontrol' , '', d)} \
#    "
#BBMASK = "meta-vuplus/recipes-graphics/"
#BBMASK += "meta-fulan/recipes-graphics/"
#BBMASK += "meta-vuplus/recipes-webkit/"

MACHINE_ESSENTIAL_EXTRA_RDEPENDS += "gfutures-dvb-modules-hd51"
MACHINE_EXTRA_RRECOMMENDS += " \
	kernel-modules \
"
##preferred versions
PREFERRED_VERSION_linux-libc-headers = "4.10"
PREFERRED_VERSION_nativesdk-linux-libc-headers = "4.10"

##preferred providers
PREFERRED_PROVIDER_virtual/kernel = "linux-gfutures"
PREFERRED_PROVIDER_virtual/neutrino = "neutrino-mp"
PREFFERED_PROVIDER_virtual/libstb-hal = "libstb-hal"
PREFFERED_PROVIDER_virtual/dvb-driver = "gfutures-dvb-modules-hd51"
PREFFERED_PROVIDER_virtual/screengrabber = "grab"
PREFERRED_PROVIDER_virtual/libgles1 = "hd-v3ddriver-hd51"
PREFERRED_PROVIDER_virtual/libgles2 = "hd-v3ddriver-hd51"
PREFERRED_PROVIDER_virtual/egl = "hd-v3ddriver-hd51"

MACHINE_DRIVER ?= "hd51"
MACHINE_BRAND = "AX/Mut@nt 4K"
MACHINE_NAME = "HD51"
IMAGEDIR = "hd51"
```

## conf/machine/include/arm/armv7a/tune-cortexa15.inc
```bitbake
TARGET_ARCH = "arm"
DEFAULTTUNE = "cortexa15hf-neon-vfpv4"

require conf/machine/include/tune-cortexa15.inc

PACKAGE_EXTRA_ARCHS = "cortexa15hf-neon-vfpv4"
```

## conf/machine/include/hd51/default-settings.inc
```bitbake
# AX HD51 BSP default settings


SOC_FAMILY = "bcm7251s"

MACHINE_DRIVER ?= "hd51"
MACHINE_BRAND = "AX/Mut@nt 4K"
MACHINE_NAME = "HD51"
IMAGEDIR = "hd51"
IMAGE_LINK = "${IMAGE_NAME}-hd51"
MTD_ROOTFS = "mmcblk0p3"
MTD_KERNEL = "mmcblk0p2"
KERNEL_FILE = "kernel.bin"
ROOTFS_FILE = "rootfs.tar.bz2"

#IMAGE_CLASSES += "hd-emmc_image_single"
IMAGE_CLASSES += "hd-emmc_image_multiboot"


IMAGE_FSTYPES += "hd-emmc"
```
